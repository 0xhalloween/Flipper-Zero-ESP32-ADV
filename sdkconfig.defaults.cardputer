## sdkconfig.defaults.cardputer
```kconfig
# =============================================================================
# M5Stack Cardputer (Standard) Optimized Configuration
# =============================================================================

# Flash Configuration
CONFIG_ESPTOOLPY_FLASHSIZE_8MB=y
CONFIG_ESPTOOLPY_FLASHSIZE="8MB"

# PSRAM is not present on standard Cardputer
CONFIG_SPIRAM=n

# =============================================================================
# Logging & Console Configuration (FREE GPIO 43/44)
# =============================================================================
CONFIG_ESP_CONSOLE_UART_DEFAULT=n
CONFIG_ESP_CONSOLE_USB_SERIAL_JTAG=y
CONFIG_ESP_CONSOLE_UART_CUSTOM=n
CONFIG_ESP_CONSOLE_UART_NONE=y

CONFIG_LOG_DEFAULT_LEVEL_INFO=y
CONFIG_LOG_MAXIMUM_LEVEL_INFO=y
CONFIG_LOG_DEFAULT_LEVEL=3

# Specific component log levels
CONFIG_LOG_WIFI_LEVEL_WARNING=y
CONFIG_LOG_BT_LEVEL_WARNING=y

# =============================================================================
# TinyUSB Configuration (Disable CDC to favor Serial JTAG)
# =============================================================================
CONFIG_TINYUSB_HID_COUNT=1
CONFIG_TINYUSB_DESC_BOS_ENABLED=y
CONFIG_TINYUSB_HID_BUFSIZE=16
CONFIG_TINYUSB_CDC_ENABLED=n
```

## sdkconfig.defaults.esp32s3
```kconfig
# Target-specific overrides for ESP32-S3 boards
# These are merged ON TOP OF sdkconfig.defaults when building with:
#   idf.py -B build_s3 set-target esp32s3

# ESP32-S3 is dual-core Xtensa — keep unicore for Furi compatibility
CONFIG_FREERTOS_UNICORE=y

# BLE: Use legacy 4.2 advertising (5.0 extended adv not seen by all phones)
CONFIG_BT_BLE_42_FEATURES_SUPPORTED=y
# CONFIG_BT_BLE_50_FEATURES_SUPPORTED is not set

# NFC needs 3DES (felica, mf_ultralight)
CONFIG_MBEDTLS_DES_C=y

# TinyUSB (USB HID for BadUSB over wired USB)
# HID + Keyboard + Mouse + Consumer Control packed into one interface.
CONFIG_TINYUSB_HID_COUNT=1
CONFIG_TINYUSB_HID_BUFSIZE=16
# Leave other classes off - we only need HID for BadUSB.
CONFIG_TINYUSB_CDC_ENABLED=n
CONFIG_TINYUSB_MSC_ENABLED=n
CONFIG_TINYUSB_MIDI_ENABLED=n
CONFIG_TINYUSB_NCM_ENABLED=n
CONFIG_TINYUSB_DEBUG_LEVEL=1

# esp_http_server: increase header / URI limits for Evil Portal so smartphones
# with large cookie sets don't trip the 431 "Request Header Fields Too Large" error.
CONFIG_HTTPD_MAX_REQ_HDR_LEN=4096
CONFIG_HTTPD_MAX_URI_LEN=2048
```

## sdkconfig.defaults.t_embed
```kconfig
# Target-specific overrides for LilyGo T-Embed CC1101
CONFIG_ESPTOOLPY_FLASHSIZE_16MB=y
CONFIG_ESPTOOLPY_FLASHSIZE="16MB"
CONFIG_SPIRAM=y
CONFIG_SPIRAM_MODE_OCT=y
CONFIG_SPIRAM_SPEED_80M=y
CONFIG_SPIRAM_USE_MALLOC=y
CONFIG_SPIRAM_MALLOC_ALWAYSINTERNAL=4096
CONFIG_SPIRAM_MALLOC_RESERVE_INTERNAL=65536
CONFIG_SPIRAM_ALLOW_STACK_EXTERNAL_MEMORY=y
CONFIG_SPIRAM_FETCH_INSTRUCTIONS=y
CONFIG_SPIRAM_RODATA=y
CONFIG_SPIRAM_ALLOW_BSS_SEG_EXTERNAL_MEMORY=y
```
